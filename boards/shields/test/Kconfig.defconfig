## boards/shields/test/Kconfig.defconfig
```kconfig
if SHIELD_TEST_LEFT

config ZMK_KEYBOARD_NAME
    default "test"

config ZMK_SPLIT_ROLE_CENTRAL
    default y

endif # SHIELD_TEST_LEFT

if SHIELD_TEST_LEFT || SHIELD_TEST_RIGHT

config ZMK_SPLIT
    default y

endif # SHIELD_TEST_LEFT || SHIELD_TEST_RIGHT
```

## boards/shields/test/Kconfig.shield
```kconfig
config SHIELD_TEST_LEFT
    def_bool $(shields_list_contains,test_left)

config SHIELD_TEST_RIGHT
    def_bool $(shields_list_contains,test_right)
```
